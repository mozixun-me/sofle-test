## config/west.yml
```yaml
manifest:
  remotes:
    - name: zmkfirmware
      url-base: https://github.com/zmkfirmware
    - name: mozixun-me
      url-base: https://github.com/mozixun-me
  projects:
    - name: zmk-test
      remote: mozixun-me
      revision: sofle-bongo-cat-update
      import: app/west.yml
  self:
    path: config
```
